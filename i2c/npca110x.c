#include<string.h>
#include <reg51.h>
#include <intrins.h>
#include "syscfg.h"
#include "type.h"
#include "utility.h"
#include "debug.h"
#include "i2c.h"
#include "npca110x.h"
#include "display.h"
#ifdef FUNC_NPCA110X_EN
BOOL isDefaultBass = TRUE;
BYTE CurrentVolume = 8;
extern BOOL isDealSetBass;
BYTE CODE gDACOUTGain[VOLUME_MAX + 1] = 
{
	0x00,	0x02,	0x04,	0x06,	0x08,	0x0a,	0x0c,	0x0e,
	0x10,	0x12, 	0x14,	0x16,	0x18,	0x1a,	0x1c,	0x1e,
	0x20,	0x22,	0x24,	0x26,	0x28,	0x2a,	0x2c,	0x2e,
	0x30,	0x32,	0x34,	0x36,	0x38,	0x3a,	0x3c,	0x3e,
	0x40,	0x42,	0x44,	0x46,	0x48,	0x4a,	0x4c,	0x4e,
	0x50,	0x52,	0x54,
};


BYTE  CODE g_abMaxxDSPCommands1[][3] =
{
{0x00, 0xa5, 0x00},
{0x00, 0xa5, 0x00},
{0x00, 0xc3, 0x00},
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{0x0c, 0xc4, 0xa0},
};

BYTE  CODE g_abMaxxDSPCommands2[][3] =
{
{0x00, 0x00, 0x16},
{0x57, 0xf4, 0x00},
{0x7f, 0xf7, 0x05},
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{0x02, 0xa7, 0xf3},
};

BYTE  CODE g_abMaxxDSPCommands3[][3] =
{
{0x06, 0x3b, 0x5f},
{0x02, 0xa7, 0xf4},
{0x06, 0x9a, 0x3d},
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{0x00, 0x85, 0x00},
};

#if 0
{
    {0x00, 0xa5, 0x00}, /* Command DETECT                             */
    {0x00, 0xa5, 0x00}, /* Command DETECT                             */
    {0x00, 0xc3, 0x00}, /* Command SAMPLE, Value = 48 kHz             */
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    {0x00, 0xc2, 0x00}, /* Command SPEAKER, Value = 2.0               */
    /* System Configuration End */                  
    /* Algorithms Configuration Begin */
    {0x00, 0xc9, 0x78}, /* Command BALANCE, Value = 0                 */
    {0x00, 0xdf, 0x1e}, /* Command LEVELER_TARGET, Value = -6.0       */
    {0x00, 0xdb, 0x78}, /* Command LEVELER_RANGE, Value = -24.0       */
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    {0x00, 0xcf, 0x01}, /* Command Internal                           */
    /* Patch Begin */
    {0xff, 0xab, 0xf4}, /*                                            */
    {0x00, 0x00, 0x01}, /*                                            */
    {0xff, 0xab, 0xf5}, /*                                            */
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    {0x20, 0xcf, 0x00}, /*                                            */
    /* Algorithms Configuration End */
    {0x6c, 0xf0, 0x00}, /*                                            */
    {0x00, 0x02, 0x4e}, /*                                            */
    {0x74, 0xf4, 0x00}, /*                                            */
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    {0x03, 0xa7, 0x07}, /*                                            */
     /* Algorithms Configuration Begin */
    {0x13, 0xc9, 0x21}, /*                                            */
    {0x03, 0xa7, 0x08}, /*                                            */
    {0x14, 0xf6, 0x56}, /*                                            */
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    {0x77, 0xf3, 0xd5}, /*                                            */
    /* Patch End */ 
    {0x00, 0xac, 0x00}, /* Command COMLET_SETTING                     */
    {0x00, 0x85, 0x00}, /* Command Internal                           */
}
#endif

BOOL NPCA110X_IIC_Send_Cmd(BYTE *cmd)
{
	BOOL acktemp = 0;
	I2C_Start(NPCA110X_IIC);
	acktemp = I2C_WriteByte(NPCA110X_ADDR,NPCA110X_IIC);
//		acktemp |= I2C_WriteDWord(TransmissionCMD,NPCA110X_IIC);
	acktemp |= I2C_WriteBytes(cmd,3,NPCA110X_IIC);
	I2C_Stop(NPCA110X_IIC);
	WaitMs(1);

	return acktemp;
}




BOOL NPCA110X_Init(VOID)
{
	//DWORD TransmissionCMD;
	BYTE *TransmissionCMD;
	BOOL acktemp = 0;

	BYTE i;
	for(i = 0; i< sizeof(g_abMaxxDSPCommands1)/3; i++)
	{
		FeedWatchDog();

//		TransmissionCMD = (NPCA110X_ADDR<<24|g_abMaxxDSPCommands1[i][0]<<16|g_abMaxxDSPCommands1[i][1]<<8|g_abMaxxDSPCommands1[i][2]);
		TransmissionCMD = g_abMaxxDSPCommands1[i];
		acktemp = NPCA110X_IIC_Send_Cmd(TransmissionCMD);
	}

	for(i = 0; i< sizeof(g_abMaxxDSPCommands2)/3; i++)
	{
		FeedWatchDog();

//		TransmissionCMD = (NPCA110X_ADDR<<24|g_abMaxxDSPCommands1[i][0]<<16|g_abMaxxDSPCommands1[i][1]<<8|g_abMaxxDSPCommands1[i][2]);
		TransmissionCMD = g_abMaxxDSPCommands2[i];
		acktemp |= NPCA110X_IIC_Send_Cmd(TransmissionCMD);
	}

	for(i = 0; i< sizeof(g_abMaxxDSPCommands3)/3; i++)
	{
		FeedWatchDog();

//		TransmissionCMD = (NPCA110X_ADDR<<24|g_abMaxxDSPCommands1[i][0]<<16|g_abMaxxDSPCommands1[i][1]<<8|g_abMaxxDSPCommands1[i][2]);
		TransmissionCMD = g_abMaxxDSPCommands3[i];
		acktemp |= NPCA110X_IIC_Send_Cmd(TransmissionCMD);
	}
	DBG(("end5555555555555555555555555555555\n"));

	//Set_AudioCodec_Volume(Volume_Map_to_MaxxiAudio[CurrentVolume]);

	return acktemp;
}

#ifdef AU6210K_NR_D_8_CSRBT
static BOOL NPCA110X_SendCODE_Latch_CMD(VOID)
{	
	BYTE  CODE g_CODE_Latch_CMD[][3] =
	{
	  0xFF, 0xAD, 0x86,   // CODEC Latch 
	  0x00, 0x00, 0x00,   
	  0xFF, 0xAD, 0x86,   
	  0x00, 0x00, 0x01,  
  	  0xFF, 0xAD, 0x86,   
	  0x00, 0x00, 0x00,   

	};
	BYTE *TransmissionCMD;
	BYTE i;	
	BOOL acktemp = 0;

	for(i = 0; i< sizeof(g_CODE_Latch_CMD)/3; i++)
	{
		FeedWatchDog();
		TransmissionCMD = g_CODE_Latch_CMD[i];
		acktemp |= NPCA110X_IIC_Send_Cmd(TransmissionCMD);
	}
	return acktemp;


}
BOOL NPCA110X_NormalBass(USHORT i,BassLedCallbackFun BassCallFun)
{
	BOOL acktemp = 0;
	BYTE *TransmissionCMD;	
	BYTE  CODE gSetDSPNormalBass_CMD1[][3] = 
{
{0x00, 0xc9, 0x78},
{0x00, 0xdf, 0x1e},
{0x00, 0xdb, 0x78},
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{0x00, 0xcf, 0x00},
		};

	if(i< sizeof(gSetDSPNormalBass_CMD1)/3)
	{
		//FeedWatchDog();
		TransmissionCMD = gSetDSPNormalBass_CMD1[i];
		acktemp |= NPCA110X_IIC_Send_Cmd(TransmissionCMD);
	}
	else
	{
		BassCallFun();
		isDealSetBass = FALSE;
	}
	DBG1(("i = %d",i));
	return acktemp;		
}
BOOL NPCA110X_SetBass(USHORT i, BassLedCallbackFun BassCallFun)
{
	BOOL acktemp = 0;
	BYTE *TransmissionCMD;

BYTE  CODE gSetDSPBass_CMD1[][3] = 
{
{0x00, 0xc9, 0x78},
{0x00, 0xdf, 0x1e},
{0x00, 0xdb, 0x78},
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{0x00, 0xcf, 0x00},
};
	if(i< sizeof(gSetDSPBass_CMD1)/3)
	{
		//FeedWatchDog();
		TransmissionCMD = gSetDSPBass_CMD1[i];
		acktemp |= NPCA110X_IIC_Send_Cmd(TransmissionCMD);
	}
	else
	{
		BassCallFun();
		isDealSetBass = FALSE;
	}
	DBG1(("i = %d",i));
	return acktemp;

	
}

BOOL NPCA110X_SetMaxxBass(BYTE Channel)
{
	BOOL acktemp = 0;
	const BYTE gBassDSP_CMD[3] = {0x00, 0xd1, 0x0f};
	acktemp = NPCA110X_IIC_Send_Cmd(gBassDSP_CMD);
	return acktemp;		
}


//设置npca110x输出脚OUT的mute on=TRUE 为mute
BOOL NPCA110X_SetOutMute(BOOL on)
{
	BOOL acktemp = 0;
	BYTE gBassDSP_CMD[3] = {0x00,0xc7,0x00} ;
	
	gBassDSP_CMD[2] = (on?01:00);
	acktemp = NPCA110X_IIC_Send_Cmd(gBassDSP_CMD);
	
	if(!on)//e0命令设置放mute的时间，0a为10ms
	{
		gBassDSP_CMD[1] = 0xe0;
		gBassDSP_CMD[2] = 0x0a;
		acktemp |= NPCA110X_IIC_Send_Cmd(gBassDSP_CMD);
	}		
	return acktemp;		
}

BOOL NPCA110X_ADC_Input_CH_Select(INPUT_CH ch)
{
	BOOL acktemp = 0;
	BYTE Ch_temp,gBassDSP_CMD[3] = {0xff,0xad,0x83} ;	
	Ch_temp = (((BYTE)ch<<4)&0xf0) | ((BYTE)ch&0x0f);
	acktemp = NPCA110X_IIC_Send_Cmd(gBassDSP_CMD);	
	gBassDSP_CMD[0] = 0x00;	
	gBassDSP_CMD[1] = 0x00;
	gBassDSP_CMD[2] = Ch_temp;
	acktemp |= NPCA110X_IIC_Send_Cmd(gBassDSP_CMD);
	acktemp |= NPCA110X_SendCODE_Latch_CMD();
	WaitMs(2);
	return acktemp;		
}


BOOL NPCA110X_DAC1_Set_Volume_and_Mute(BYTE Vol)
{
	BOOL acktemp = 0;
	BYTE gBassDSP_CMD[3] = {0xff,0xad,0x80} ;	
	acktemp = NPCA110X_IIC_Send_Cmd(gBassDSP_CMD);	
	gBassDSP_CMD[0] = 0x00;	
	gBassDSP_CMD[1] = gDACOUTGain[Vol];
	gBassDSP_CMD[2] = gDACOUTGain[Vol];
	acktemp |= NPCA110X_IIC_Send_Cmd(gBassDSP_CMD);
	acktemp |= NPCA110X_SendCODE_Latch_CMD();
	WaitMs(5);
	return acktemp;		
}


#endif

#endif


